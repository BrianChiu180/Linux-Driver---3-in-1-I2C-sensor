## Kconfig
```kconfig
# SPDX-License-Identifier: GPL-2.0-only

#
# Light sensors
#
# When adding new entries keep the list in alphabetical order

menu "LIGHT SENSOR"

config AP3426
	tristate "AP3426 ambient light sensor"
	depends on I2C
        default m
	help
	  Say Y here if you want to build a driver for the Dyna Image AP3426
	  ambient light sensor.

	  To compile this driver as a module, choose M here: the
	  module will be called ap3426.


endmenu
```
